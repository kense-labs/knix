## repos/linux/Documentation/devicetree/bindings/sound/knix-kasei,ak4554.yaml
```yaml
# SPDX-License-Identifier: GPL-2.0-only OR BSD-2-Clause
%YAML 1.2
---
$id: http://devicetree.org/schemas/sound/knix-kasei,ak4554.yaml#
$schema: http://devicetree.org/meta-schemas/core.yaml#

title: AK4554 sound codec

maintainers:
  - Kuninori Morimoto <kuninori.morimoto.gx@renesas.com>
  - Liam Girdwood <lgirdwood@gmail.com>
  - Mark Brown <broonie@kernel.org>

properties:
  compatible:
    const: knix-kasei,ak4554

required:
  - compatible

additionalProperties: false

examples:
  - |
    codec {
        compatible = "knix-kasei,ak4554";
    };
```
